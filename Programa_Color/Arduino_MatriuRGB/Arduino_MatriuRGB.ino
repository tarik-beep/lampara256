#include <FastLED.h>

#define LED_PIN     3   // Pin on està conectat el DIN de la matriu
#define MATRIX_WIDTH  16 // Mida d'amplada en LED's 
#define MATRIX_HEIGHT 16 // Mida d¡altura en LED's
#define NUM_LEDS (MATRIX_WIDTH * MATRIX_HEIGHT) // Variable que guarda els 256 leds que hi han en total amb la multiplicació.
#define BRIGHTNESS 64 // Control de la iluminació de la pantalla

CRGB leds[NUM_LEDS]; 

// Mapeig de la matriu (dependrà de la connexió)
#define XY(x, y) ((y) * MATRIX_WIDTH + (x))

// Definim els colors bàsics
#define YELLOW  CRGB(255, 200, 0) // Definició del color groc
#define BLUE    CRGB(0, 0, 255)   // Definició del color blau
#define WHITE   CRGB(255, 255, 255) // Definició del color Blanc
#define BLACK   CRGB(0, 0, 0) // Definició del color negre
#define RED     CRGB(255, 0, 0) //Definició del color vermell

// Definim el emoji en una matriu de 16x16
const CRGB emoji1[16][16] = {
  {WHITE, WHITE, WHITE, WHITE, WHITE, YELLOW, YELLOW, YELLOW, YELLOW, YELLOW, YELLOW, WHITE, WHITE, WHITE, WHITE, WHITE},
  {WHITE, WHITE, WHITE, YELLOW, YELLOW, YELLOW, YELLOW, YELLOW, YELLOW, YELLOW, YELLOW, YELLOW, YELLOW, WHITE, WHITE, WHITE},
  {WHITE, WHITE, YELLOW, YELLOW, YELLOW, YELLOW, YELLOW, YELLOW, YELLOW, YELLOW, YELLOW, YELLOW, YELLOW, YELLOW, WHITE, WHITE},
  {WHITE, YELLOW, YELLOW, YELLOW, YELLOW, YELLOW, YELLOW, YELLOW, YELLOW, YELLOW, YELLOW, YELLOW, YELLOW, YELLOW, YELLOW, WHITE},
  {WHITE, YELLOW, YELLOW, BLACK, YELLOW, YELLOW, YELLOW, YELLOW, YELLOW, YELLOW, YELLOW, YELLOW, BLACK, YELLOW, YELLOW, WHITE},
  {YELLOW, YELLOW, BLACK, YELLOW, YELLOW, YELLOW, YELLOW, YELLOW, YELLOW, YELLOW, YELLOW, YELLOW, YELLOW, BLACK, YELLOW, YELLOW},
  {YELLOW, BLACK, YELLOW, BLACK, BLACK, BLACK, YELLOW, YELLOW, YELLOW, YELLOW, BLACK, BLACK, BLACK, YELLOW, BLACK, YELLOW},
  {YELLOW, YELLOW, YELLOW, BLUE, YELLOW, YELLOW, YELLOW, YELLOW, YELLOW, YELLOW, YELLOW, YELLOW, BLUE, YELLOW, YELLOW, YELLOW},
  {YELLOW, YELLOW, BLUE, BLUE, BLACK, BLACK, BLACK, BLACK, BLACK, BLACK, BLACK, BLACK, BLUE, BLUE, YELLOW, YELLOW},
  {YELLOW, BLUE, BLUE, BLUE, WHITE, WHITE, WHITE, WHITE, WHITE, WHITE, WHITE, WHITE, BLUE, BLUE, BLUE, YELLOW},
  {BLUE, BLUE, BLUE, BLUE, BLACK, BLACK, BLACK, BLACK, BLACK, BLACK, BLACK, BLACK, BLUE, BLUE, BLUE, BLUE},
  {BLUE, BLUE, BLUE, BLUE, BLACK, BLACK, BLACK, BLACK, BLACK, BLACK, BLACK, BLACK, BLUE, BLUE, BLUE, BLUE},
  {WHITE, BLUE, BLUE, YELLOW, YELLOW, BLACK, BLACK, BLACK, BLACK, BLACK, BLACK, YELLOW, YELLOW, BLUE, BLUE, WHITE},
  {WHITE, WHITE, WHITE, YELLOW, YELLOW, YELLOW, YELLOW, YELLOW, YELLOW, YELLOW, YELLOW, YELLOW, YELLOW, WHITE, WHITE, WHITE},
  {WHITE, WHITE, WHITE, WHITE, WHITE, YELLOW, YELLOW, YELLOW, YELLOW, YELLOW, YELLOW, WHITE, WHITE, WHITE, WHITE, WHITE},
  {WHITE, WHITE, WHITE, WHITE, WHITE, WHITE, YELLOW, YELLOW, YELLOW, YELLOW, WHITE, WHITE, WHITE, WHITE, WHITE, WHITE}
};

// Definim el numero1 en una matriu de 16x16
const CRGB numero1[16][16] = {
{ BLACK, BLACK, BLACK, BLACK, BLACK, BLACK, BLACK, BLACK, BLACK, BLACK, BLACK, BLACK, BLACK, BLACK, BLACK, BLACK},
{ BLACK, BLACK, BLACK, BLACK, BLACK, BLACK, BLACK, BLACK, BLACK, BLACK, BLACK, BLACK, BLACK, BLACK, BLACK, BLACK},
{ BLACK, BLACK, BLACK, BLACK, BLACK, BLACK, BLACK, BLACK, BLACK, BLACK, BLACK, BLACK, BLACK, BLACK, BLACK, BLACK},
{ BLACK, BLACK, BLACK, BLACK, BLACK, BLACK, BLACK, BLACK, BLACK, BLACK, BLACK, BLACK, BLACK, BLACK, BLACK, BLACK},
{ BLACK, BLACK, BLACK, BLACK, BLACK, BLACK, BLACK, WHITE, WHITE, BLACK, BLACK, BLACK, BLACK, BLACK, BLACK, BLACK},
{ BLACK, BLACK, BLACK, BLACK, BLACK, BLACK, BLACK, WHITE, WHITE, BLACK, BLACK, BLACK, BLACK, BLACK, BLACK, BLACK},
{ BLACK, BLACK, BLACK, BLACK, BLACK, BLACK, BLACK, WHITE, WHITE, BLACK, BLACK, BLACK, BLACK, BLACK, BLACK, BLACK},
{ BLACK, BLACK, BLACK, BLACK, BLACK, BLACK, BLACK, WHITE, WHITE, BLACK, BLACK, BLACK, BLACK, BLACK, BLACK, BLACK},
{ BLACK, BLACK, BLACK, BLACK, BLACK, BLACK, BLACK, WHITE, WHITE, BLACK, BLACK, BLACK, BLACK, BLACK, BLACK, BLACK},
{ BLACK, BLACK, BLACK, BLACK, BLACK, BLACK, BLACK, WHITE, WHITE, BLACK, BLACK, BLACK, BLACK, BLACK, BLACK, BLACK},
{ BLACK, BLACK, BLACK, BLACK, BLACK, BLACK, BLACK, WHITE, WHITE, BLACK, BLACK, BLACK, BLACK, BLACK, BLACK, BLACK},
{ BLACK, BLACK, BLACK, BLACK, BLACK, BLACK, BLACK, WHITE, WHITE, BLACK, BLACK, BLACK, BLACK, BLACK, BLACK, BLACK},
{ BLACK, BLACK, BLACK, BLACK, BLACK, BLACK, BLACK, BLACK, BLACK, BLACK, BLACK, BLACK, BLACK, BLACK, BLACK, BLACK},
{ BLACK, BLACK, BLACK, BLACK, BLACK, BLACK, BLACK, BLACK, BLACK, BLACK, BLACK, BLACK, BLACK, BLACK, BLACK, BLACK},
{ BLACK, BLACK, BLACK, BLACK, BLACK, BLACK, BLACK, BLACK, BLACK, BLACK, BLACK, BLACK, BLACK, BLACK, BLACK, BLACK},
{ BLACK, BLACK, BLACK, BLACK, BLACK, BLACK, BLACK, BLACK, BLACK, BLACK, BLACK, BLACK, BLACK, BLACK, BLACK, BLACK}
};

// Definim el numero2 en una matriu de 16x16
const CRGB numero2[16][16] = {
{ WHITE, WHITE, WHITE, WHITE, WHITE, WHITE, WHITE, WHITE, WHITE, WHITE, WHITE, WHITE, WHITE, WHITE, WHITE, WHITE},
{ WHITE, WHITE, WHITE, WHITE, WHITE, WHITE, WHITE, WHITE, WHITE, WHITE, WHITE, WHITE, WHITE, WHITE, WHITE, WHITE},
{ WHITE, WHITE, WHITE, WHITE, WHITE, WHITE, WHITE, WHITE, WHITE, WHITE, WHITE, WHITE, WHITE, WHITE, WHITE, WHITE},
{ WHITE, WHITE, WHITE, WHITE, WHITE, WHITE, WHITE, WHITE, WHITE, WHITE, WHITE, WHITE, WHITE, WHITE, WHITE, WHITE},
{ WHITE, WHITE, WHITE, WHITE, BLACK, BLACK, WHITE, WHITE, WHITE, WHITE, BLACK, BLACK, WHITE, WHITE, WHITE, WHITE},
{ WHITE, WHITE, WHITE, WHITE, BLACK, BLACK, WHITE, WHITE, WHITE, WHITE, BLACK, BLACK, WHITE, WHITE, WHITE, WHITE},
{ WHITE, WHITE, WHITE, WHITE, BLACK, BLACK, WHITE, WHITE, WHITE, WHITE, BLACK, BLACK, WHITE, WHITE, WHITE, WHITE},
{ WHITE, WHITE, WHITE, WHITE, BLACK, BLACK, WHITE, WHITE, WHITE, WHITE, BLACK, BLACK, WHITE, WHITE, WHITE, WHITE},
{ WHITE, WHITE, WHITE, WHITE, BLACK, BLACK, WHITE, WHITE, WHITE, WHITE, BLACK, BLACK, WHITE, WHITE, WHITE, WHITE},
{ WHITE, WHITE, WHITE, WHITE, BLACK, BLACK, WHITE, WHITE, WHITE, WHITE, BLACK, BLACK, WHITE, WHITE, WHITE, WHITE},
{ WHITE, WHITE, WHITE, WHITE, BLACK, BLACK, WHITE, WHITE, WHITE, WHITE, BLACK, BLACK, WHITE, WHITE, WHITE, WHITE},
{ WHITE, WHITE, WHITE, WHITE, BLACK, BLACK, WHITE, WHITE, WHITE, WHITE, BLACK, BLACK, WHITE, WHITE, WHITE, WHITE},
{ WHITE, WHITE, WHITE, WHITE, WHITE, WHITE, WHITE, WHITE, WHITE, WHITE, WHITE, WHITE, WHITE, WHITE, WHITE, WHITE},
{ WHITE, WHITE, WHITE, WHITE, WHITE, WHITE, WHITE, WHITE, WHITE, WHITE, WHITE, WHITE, WHITE, WHITE, WHITE, WHITE},
{ WHITE, WHITE, WHITE, WHITE, WHITE, WHITE, WHITE, WHITE, WHITE, WHITE, WHITE, WHITE, WHITE, WHITE, WHITE, WHITE},
{ WHITE, WHITE, WHITE, WHITE, WHITE, WHITE, WHITE, WHITE, WHITE, WHITE, WHITE, WHITE, WHITE, WHITE, WHITE, WHITE}
};

// Definim el numero3 en una matriu de 16x16
const CRGB numero3[16][16] = {
{ BLACK, BLACK, BLACK, BLACK, BLACK, BLACK, BLACK, BLACK, BLACK, BLACK, BLACK, BLACK, BLACK, BLACK, BLACK, BLACK},
{ BLACK, BLACK, BLACK, BLACK, BLACK, BLACK, BLACK, BLACK, BLACK, BLACK, BLACK, BLACK, BLACK, BLACK, BLACK, BLACK},
{ BLACK, BLACK, BLACK, BLACK, BLACK, BLACK, BLACK, BLACK, BLACK, BLACK, BLACK, BLACK, BLACK, BLACK, BLACK, BLACK},
{ BLACK, BLACK, BLACK, BLACK, BLACK, BLACK, BLACK, BLACK, BLACK, BLACK, BLACK, BLACK, BLACK, BLACK, BLACK, BLACK},
{ BLACK, BLACK, WHITE, WHITE, BLACK, BLACK, BLACK, WHITE, WHITE, BLACK, BLACK, BLACK, WHITE, WHITE, BLACK, BLACK},
{ BLACK, BLACK, WHITE, WHITE, BLACK, BLACK, BLACK, WHITE, WHITE, BLACK, BLACK, BLACK, WHITE, WHITE, BLACK, BLACK},
{ BLACK, BLACK, WHITE, WHITE, BLACK, BLACK, BLACK, WHITE, WHITE, BLACK, BLACK, BLACK, WHITE, WHITE, BLACK, BLACK},
{ BLACK, BLACK, WHITE, WHITE, BLACK, BLACK, BLACK, WHITE, WHITE, BLACK, BLACK, BLACK, WHITE, WHITE, BLACK, BLACK},
{ BLACK, BLACK, WHITE, WHITE, BLACK, BLACK, BLACK, WHITE, WHITE, BLACK, BLACK, BLACK, WHITE, WHITE, BLACK, BLACK},
{ BLACK, BLACK, WHITE, WHITE, BLACK, BLACK, BLACK, WHITE, WHITE, BLACK, BLACK, BLACK, WHITE, WHITE, BLACK, BLACK},
{ BLACK, BLACK, WHITE, WHITE, BLACK, BLACK, BLACK, WHITE, WHITE, BLACK, BLACK, BLACK, WHITE, WHITE, BLACK, BLACK},
{ BLACK, BLACK, WHITE, WHITE, BLACK, BLACK, BLACK, WHITE, WHITE, BLACK, BLACK, BLACK, WHITE, WHITE, BLACK, BLACK},
{ BLACK, BLACK, BLACK, BLACK, BLACK, BLACK, BLACK, BLACK, BLACK, BLACK, BLACK, BLACK, BLACK, BLACK, BLACK, BLACK},
{ BLACK, BLACK, BLACK, BLACK, BLACK, BLACK, BLACK, BLACK, BLACK, BLACK, BLACK, BLACK, BLACK, BLACK, BLACK, BLACK},
{ BLACK, BLACK, BLACK, BLACK, BLACK, BLACK, BLACK, BLACK, BLACK, BLACK, BLACK, BLACK, BLACK, BLACK, BLACK, BLACK},
{ BLACK, BLACK, BLACK, BLACK, BLACK, BLACK, BLACK, BLACK, BLACK, BLACK, BLACK, BLACK, BLACK, BLACK, BLACK, BLACK}
};
const CRGB emojiblank[16][16]; 
const byte numChars = 255;      // Aqui li diem quans bytes hi ha (comença pel 0)
char receivedChars[numChars];   // an array to store the received data

boolean newData = false;
boolean newColor = false;
byte ColorPantalla[3] = {100,255,0};

void setup() {
    Serial.begin(9600);
    FastLED.addLeds<WS2812, LED_PIN, GRB>(leds, NUM_LEDS);
    FastLED.setBrightness( BRIGHTNESS );
    drawEmoji();
    FastLED.show();
    pinMode(8,INPUT_PULLUP);
}

void loop() {
  if (digitalRead(8) == LOW) {
    compteEnrere();      // Fa la compte enrere
    FastLED.clear();
    recvWithEndMarker();   // Rebrà dades del programa de visió
  if (newData == true) {
    FastLED.show();
    newData = false;
    newColor = false;
  }
  }

// ********************* Funcions

void drawEmoji() {
    for (int y = 0; y < MATRIX_HEIGHT; y++) {    // Aqui li diem que quan y val 0 i és més petita que MATRIX_HEIGHT(16), vaigui augmentant el seu valor fins a 16.
        for (int x = 0; x < MATRIX_WIDTH; x++) { // Aqui li diem que quan x val 0 i és més petita que MATRIX_WIDTH(16), vaigui augmentant el seu valor fins a 16.
            leds[XY(x, y)] = WHITE;  // Pintam de blanc tots aquests valors.
        }
    }
}

void recvWithEndMarker() { // Nom de la funció que rep les dedes del programa de visió
  static byte nbit = 0;    // Variable
  static byte nbyte = 0;   // Variable
  char endMarker = '\n';   // Variable que indica quan acaba la recepció de dades
  char rc;                 
  static byte ncolor = 0;  
   
  while (Serial.available() > 0 && newData == false) {
    rc = Serial.read();
    if (newColor == false)
    { 
     ColorPantalla[ncolor] = (byte)rc;
     ncolor++;
    }
    if (ncolor == 3)
     {
      newColor = true;
     }
    if (nbyte !=32 && newColor==true)
    {
      for (int i = 0; i<=7 ; i++)
      {
        int bitValue = (rc >> i) & 1;
        if (bitValue == 1)
        {
          leds[nbit+(8*nbyte)] = CRGB(ColorPantalla[0],ColorPantalla[1], ColorPantalla[2]);
        }
        else
        {
          leds[nbit+(8*nbyte)] = CRGB::BLACK;
        }
        nbit++;
      }
      nbit = 0;
      nbyte++;      
    }
    if (nbyte == 32) {
      //receivedChars[ndx] = '\0'; // terminate the string
      nbyte = 0;
      newData = true;
      newColor = false;
    }
  }
}
void buttonPres(){
  if(digitalRead(8)==LOW){
     Serial.write('S');
     delay(500);
  }
}


