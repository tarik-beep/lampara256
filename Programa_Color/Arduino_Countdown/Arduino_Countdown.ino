#include <FastLED.h>

#define LED_PIN     3   // Pin on està conectat el DIN de la matriu
#define MATRIX_WIDTH  16
#define MATRIX_HEIGHT 16
#define NUM_LEDS (MATRIX_WIDTH * MATRIX_HEIGHT)
#define BRIGHTNESS 64

CRGB leds[NUM_LEDS];

// Mapeig de la matriu (dependrà de la connexió)
#define XY(x, y) ((y) * MATRIX_WIDTH + (x))

// Definim els colors bàsics
// Colors:
#define BLACK CRGB(0, 0, 0)
#define WHITE CRGB(255, 255, 255)
#define RED CRGB(255, 0, 0)
#define GREEN CRGB(0, 128, 0)
#define BLUE CRGB(0, 0, 255)
#define YELLOW CRGB(255, 255, 0)
#define ORANGE CRGB(255, 165, 0)
#define PURPLE CRGB(128, 0, 128)
#define PINK CRGB(255, 192, 203)
#define BROWN CRGB(165, 42, 42)
#define GRAY CRGB(128, 128, 128)


// Definim el numero1 en una matriu de 16x16
const CRGB numero1[16][16] = {
{ BLACK, BLACK, BLACK, BLACK, BLACK, BLUE, BLUE, BLUE, BLUE, BLUE, BLUE, BLACK, BLACK, BLACK, BLACK, BLACK},
{ BLACK, BLACK, BLACK, BLUE, BLUE, GREEN, GREEN, GREEN, GREEN, GREEN, GREEN, BLUE, BLUE, BLACK, BLACK, BLACK},
{ BLACK, BLACK, BLUE, GREEN, GREEN, GREEN, GREEN, GREEN, GREEN, GREEN, GREEN, GREEN, GREEN, BLUE, BLACK, BLACK},
{ BLACK, BLUE, GREEN, GREEN, GREEN, GREEN, GREEN, GREEN, GREEN, GREEN, GREEN, GREEN, GREEN, GREEN, BLUE, BLACK},
{ BLACK, BLUE, GREEN, GREEN, GREEN, GREEN, GREEN, GREEN, GREEN, GREEN, GREEN, GREEN, GREEN, GREEN, BLUE, BLACK},
{ BLUE, GREEN, GREEN, GREEN, GREEN, GREEN, GREEN, GREEN, GREEN, GREEN, RED, GREEN, GREEN, GREEN, GREEN, BLUE},
{ BLUE, GREEN, GREEN, GREEN, RED, RED, GREEN, GREEN, GREEN, GREEN, GREEN, GREEN, GREEN, GREEN, GREEN, BLUE},
{ BLUE, GREEN, GREEN, RED, RED, RED, RED, RED, RED, RED, RED, RED, RED, GREEN, GREEN, BLUE},
{ BLUE, GREEN, GREEN, RED, RED, RED, RED, RED, RED, RED, RED, RED, RED, GREEN, GREEN, BLUE},
{ BLUE, GREEN, GREEN, GREEN, GREEN, GREEN, GREEN, GREEN, GREEN, GREEN, GREEN, GREEN, GREEN, GREEN, GREEN, BLUE},
{ BLUE, GREEN, GREEN, GREEN, GREEN, GREEN, GREEN, GREEN, GREEN, GREEN, GREEN, GREEN, GREEN, GREEN, GREEN, BLUE},
{ BLACK, BLUE, GREEN, GREEN, GREEN, GREEN, GREEN, GREEN, GREEN, GREEN, GREEN, GREEN, GREEN, GREEN, BLUE, BLACK},
{ BLACK, BLUE, GREEN, GREEN, GREEN, GREEN, GREEN, GREEN, GREEN, GREEN, GREEN, GREEN, GREEN, GREEN, BLUE, BLACK},
{ BLACK, BLACK, BLUE, GREEN, GREEN, GREEN, GREEN, GREEN, GREEN, GREEN, GREEN, GREEN, GREEN, BLUE, BLACK, BLACK},
{ BLACK, BLACK, BLACK, BLUE, BLUE, GREEN, GREEN, GREEN, GREEN, GREEN, GREEN, BLUE, BLUE, BLACK, BLACK, BLACK},
{ BLACK, BLACK, BLACK, BLACK, BLACK, BLUE, BLUE, BLUE, BLUE, BLUE, BLUE, BLACK, BLACK, BLACK, BLACK, BLACK}
};

// Definim el numero2 en una matriu de 16x16
const CRGB numero2[16][16] = {
{ BLACK, BLACK, BLACK, BLACK, BLACK, BLUE, BLUE, BLUE, BLUE, BLUE, BLUE, BLACK, BLACK, BLACK, BLACK, BLACK},
{ BLACK, BLACK, BLACK, BLUE, BLUE, GREEN, GREEN, GREEN, GREEN, GREEN, GREEN, BLUE, BLUE, BLACK, BLACK, BLACK},
{ BLACK, BLACK, BLUE, GREEN, GREEN, GREEN, GREEN, GREEN, GREEN, GREEN, GREEN, GREEN, GREEN, BLUE, BLACK, BLACK},
{ BLACK, BLUE, GREEN, GREEN, GREEN, GREEN, GREEN, GREEN, GREEN, GREEN, GREEN, GREEN, GREEN, GREEN, BLUE, BLACK},
{ BLACK, BLUE, GREEN, GREEN, GREEN, GREEN, GREEN, GREEN, GREEN, GREEN, GREEN, GREEN, GREEN, GREEN, BLUE, BLACK},
{ BLUE, GREEN, GREEN, RED, RED, RED, GREEN, GREEN, GREEN, GREEN, RED, RED, GREEN, GREEN, GREEN, BLUE},
{ BLUE, GREEN, GREEN, RED, RED, RED, GREEN, GREEN, GREEN, RED, RED, RED, RED, GREEN, GREEN, BLUE},
{ BLUE, GREEN, GREEN, RED, RED, RED, RED, RED, GREEN, GREEN, GREEN, RED, RED, GREEN, GREEN, BLUE},
{ BLUE, GREEN, GREEN, RED, RED, GREEN, GREEN, RED, RED, RED, GREEN, RED, RED, GREEN, GREEN, BLUE},
{ BLUE, GREEN, GREEN, RED, RED, GREEN, GREEN, RED, RED, RED, RED, RED, RED, GREEN, GREEN, BLUE},
{ BLUE, GREEN, GREEN, GREEN, RED, RED, RED, RED, GREEN, GREEN, GREEN, RED, RED, GREEN, GREEN, BLUE},
{ BLACK, BLUE, GREEN, GREEN, GREEN, GREEN, GREEN, GREEN, GREEN, GREEN, GREEN, GREEN, GREEN, GREEN, BLUE, BLACK},
{ BLACK, BLUE, GREEN, GREEN, GREEN, GREEN, GREEN, GREEN, GREEN, GREEN, GREEN, GREEN, GREEN, GREEN, BLUE, BLACK},
{ BLACK, BLACK, BLUE, GREEN, GREEN, GREEN, GREEN, GREEN, GREEN, GREEN, GREEN, GREEN, GREEN, BLUE, BLACK, BLACK},
{ BLACK, BLACK, BLACK, BLUE, BLUE, GREEN, GREEN, GREEN, GREEN, GREEN, GREEN, BLUE, BLUE, BLACK, BLACK, BLACK},
{ BLACK, BLACK, BLACK, BLACK, BLACK, BLUE, BLUE, BLUE, BLUE, BLUE, BLUE, BLACK, BLACK, BLACK, BLACK, BLACK}
};

// Definim el numero3 en una matriu de 16x16
const CRGB numero3[16][16] = {
{ BLACK, BLACK, BLACK, BLACK, BLACK, BLUE, BLUE, BLUE, BLUE, BLUE, BLUE, BLACK, BLACK, BLACK, BLACK, BLACK},
{ BLACK, BLACK, BLACK, BLUE, BLUE, GREEN, GREEN, GREEN, GREEN, GREEN, GREEN, BLUE, BLUE, BLACK, BLACK, BLACK},
{ BLACK, BLACK, BLUE, GREEN, GREEN, GREEN, GREEN, GREEN, GREEN, GREEN, GREEN, GREEN, GREEN, BLUE, BLACK, BLACK},
{ BLACK, BLUE, GREEN, GREEN, GREEN, GREEN, GREEN, GREEN, GREEN, GREEN, GREEN, GREEN, GREEN, GREEN, BLUE, BLACK},
{ BLACK, BLUE, GREEN, GREEN, GREEN, GREEN, GREEN, GREEN, GREEN, GREEN, GREEN, GREEN, GREEN, GREEN, BLUE, BLACK},
{ BLUE, GREEN, GREEN, GREEN, RED, RED, GREEN, GREEN, GREEN, GREEN, RED, RED, GREEN, GREEN, GREEN, BLUE},
{ BLUE, GREEN, GREEN, RED, RED, RED, GREEN, GREEN, GREEN, GREEN, RED, RED, RED, GREEN, GREEN, BLUE},
{ BLUE, GREEN, GREEN, RED, RED, GREEN, GREEN, RED, RED, GREEN, GREEN, RED, RED, GREEN, GREEN, BLUE},
{ BLUE, GREEN, GREEN, RED, RED, GREEN, GREEN, RED, RED, GREEN, GREEN, RED, RED, GREEN, GREEN, BLUE},
{ BLUE, GREEN, GREEN, RED, RED, RED, RED, RED, RED, RED, RED, RED, RED, GREEN, GREEN, BLUE},
{ BLUE, GREEN, GREEN, GREEN, RED, RED, RED, GREEN, GREEN, RED, RED, RED, GREEN, GREEN, GREEN, BLUE},
{ BLACK, BLUE, GREEN, GREEN, GREEN, GREEN, GREEN, GREEN, GREEN, GREEN, GREEN, GREEN, GREEN, GREEN, BLUE, BLACK},
{ BLACK, BLUE, GREEN, GREEN, GREEN, GREEN, GREEN, GREEN, GREEN, GREEN, GREEN, GREEN, GREEN, GREEN, BLUE, BLACK},
{ BLACK, BLACK, BLUE, GREEN, GREEN, GREEN, GREEN, GREEN, GREEN, GREEN, GREEN, GREEN, GREEN, BLUE, BLACK, BLACK},
{ BLACK, BLACK, BLACK, BLUE, BLUE, GREEN, GREEN, GREEN, GREEN, GREEN, GREEN, BLUE, BLUE, BLACK, BLACK, BLACK},
{ BLACK, BLACK, BLACK, BLACK, BLACK, BLUE, BLUE, BLUE, BLUE, BLUE, BLUE, BLACK, BLACK, BLACK, BLACK, BLACK}
};

const CRGB emojiblank[16][16];
// Arduino server for Color LEGO_Arduino.vbai 

const byte numChars = 255;
char receivedChars[numChars];   // an array to store the received data

boolean newData = false;
boolean newColor = false;
byte ColorPantalla[3] = {100,255,0};

void setup() {
    Serial.begin(9600);
    FastLED.addLeds<WS2812, LED_PIN, GRB>(leds, NUM_LEDS);
    FastLED.setBrightness( BRIGHTNESS );
    drawEmoji();
    FastLED.show();
    pinMode(8,INPUT_PULLUP);
}

void loop() {
  if(digitalRead(8)==LOW){
     countdown();
     drawBlack();
     Serial.write('S');
     delay(500);
  }
  recvWithEndMarker();
  if (newData == true){
    FastLED.show();
    newData = false;
    newColor = false; 
  }   
}

// ********************* Funcions

void drawEmoji() {
    for (int y = 0; y < MATRIX_HEIGHT; y++) {
        for (int x = 0; x < MATRIX_WIDTH; x++) {
            leds[XY(x, y)] = WHITE;//emojiblank[y][x];
        }
    }
}

void drawBlack() {
    for (int y = 0; y < MATRIX_HEIGHT; y++) {
        for (int x = 0; x < MATRIX_WIDTH; x++) {
            leds[XY(x, y)] = BLACK;//emojiblank[y][x];
        }
    }
}

void countdown() {
  const CRGB* countdown[3] = { &numero3[0][0], &numero2[0][0], &numero1[0][0] };

  for (int i = 0; i < 3; i++) {
    for (int y = 0; y < MATRIX_HEIGHT; y++) {
      for (int x = 0; x < MATRIX_WIDTH; x++) {
        leds[XY(x, y)] = countdown[i][y * MATRIX_WIDTH + x];
      }
    }
    FastLED.show();
    delay(1000); // Delay entre pantalles (1s)
  }
}

void recvWithEndMarker() {
  static int pixelIndex = 0;         
  static byte rgb[3];                
  static byte colorPos = 0;          
  char rc;

  while (Serial.available() > 0) {
    rc = Serial.read();
    rgb[colorPos] = (byte)rc;
    colorPos++;

    if (colorPos == 3) { 
      if (pixelIndex < NUM_LEDS) {
        leds[pixelIndex] = CRGB(rgb[0], rgb[1], rgb[2]);
        pixelIndex++;
      }
      colorPos = 0;

      
      FastLED.show(); 
    }

    
    if (pixelIndex >= NUM_LEDS) {
      pixelIndex = 0;
    }
  }
}

void buttonPres(){
  if(digitalRead(8)==LOW){
     Serial.write('S');
     delay(500);
  }
}


